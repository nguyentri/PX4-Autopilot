# R9A09G057H register map
Vendor: Renesas Electronics; File version: 1.0
Renesas RZ/V2H(P) (R9A09G057H), Cortex-R8 register view
Registers are 32-bit, read-write, no defined reset value unless marked. A register's access mark holds for its fields unless they carry their own. Offsets are from the block's base; lines under a group give offsets from that group; [hi:lo] are bit positions; {n}, {i} and the like mark numbered series; 'fields as' and 'values as' point back to an identical list; <NAME> marks a mode.

## Memory map
0x10400000 R_INTC size 0x7A4 — IO define file for intc.
0x10410020 R_GPIO size 0x3C24 — IO define file for gpio.
0x10420010 R_CPG size 0xD20 — IO define file for cpg.
0x10430000 R_SYSC size 0x1710 — IO define file for sysc.
0x10460000 R_TZC_SRAMM size 0x1000 — IO define file for tzc.
0x10470000 R_TZC_XSPI size 0x1000
0x10480000 R_MHU_NS0 size 0x1C — IO define file for mhu.
{0x10480000+0x20*n} R_MHU_NS{n} size 0x1C (n=1..41)
0x10480800 R_MHU_SWINT0 size 0xC — IO define file for mhu.
{0x10480800+0x10*n} R_MHU_SWINT{n} size 0xC (n=1..27)
{0x10481000+0x20*n} R_MHU_S{n} size 0x1C (n=0..41)
0x11000000 R_TSU_B0 size 0x3C — IO define file for tsu_b.
0x11030000 R_XSPI0 size 0x19C — IO define file for xspi.
0x11040000 R_PDM0 size 0x3F0 — IO define file for pdm.
0x11050000 R_PDM1 size 0x3F0
0x11400000 R_DMAC_B0 size 0x800 — IO define file for dmac.
0x11800000 R_GTM0 size 0x24 — IO define file for gtm.
0x11801000 R_GTM1 size 0x24
0x11C00000 R_ADC_E0 size 0x1EC — IO define file for adc_e.
0x11C00400 R_WDT0 size 0x8 — IO define file for wdt.
0x11C00800 R_RTC size 0x30 — IO define file for rtc.
0x11C00C00 R_RTC_RO size 0x10 — IO define file for rtc.
0x11C01000 R_RIIC8 size 0x14
0x11C01400 R_SCIFA0 size 0x18 — IO define file for scifa.
0x11C01800 R_CMTW0 size 0x28 — IO define file for cmtw.
0x11C01C00 R_CMTW1 size 0x28
0x11C02000 R_CMTW2 size 0x28
0x11C02400 R_CMTW3 size 0x28
0x12000000 R_DMAC_B3 size 0x800
0x12010000 R_DMAC_B4 size 0x800
0x12400000 R_I3C_B0 size 0x3E8 — IO define file for i3c.
0x12440000 R_CANFD size 0x1C000 — IO define file for canfd.
0x12800000 R_SPI_B0 size 0x70 — IO define file for spi.
0x12800400 R_SPI_B1 size 0x70
0x12800800 R_SPI_B2 size 0x70
0x12800C00 R_SCI0 size 0x7C — IO define file for rsci.
{0x12800C00+0x400*n} R_SCI{n} size 0x7C (n=1..9)
0x12C00000 R_GTM4 size 0x24
0x12C01000 R_GTM5 size 0x24
0x12C02000 R_GTM6 size 0x24
0x12C03000 R_GTM7 size 0x24
0x12C10000 R_SCU size 0xA0 — IO define file for scu.
0x12C10100 R_INTC_GIC size 0x1F00 — IO define file for intc_gic.
0x12C10200 R_GLOBAL_TIMER size 0x1C — IO define file for global_timer.
0x12C10600 R_PRIVATE_TIMER size 0x38 — IO define file for private_timer.
0x13000000 R_WDT2 size 0x8
0x13000400 R_WDT3 size 0x8
0x13000800 R_CRC size 0x10 — IO define file for crc.
0x13000C00 R_CMTW4 size 0x28
0x13001000 R_CMTW5 size 0x28
0x13001400 R_CMTW6 size 0x28
0x13001800 R_CMTW7 size 0x28
0x13001C00 R_POEGA size 0x4 — IO define file for poeg.
0x13002000 R_POEGB size 0x4
0x13002400 R_POEGC size 0x4
0x13002800 R_POEGD size 0x4
0x13002C00 R_POEGE size 0x4
0x13003000 R_POEGF size 0x4
0x13003400 R_POEGG size 0x4
0x13003800 R_POEGH size 0x4
0x13010000 R_GPT0 size 0xDC — IO define file for gpt.
0x13010100 R_GPT1 size 0xDC
0x13010200 R_GPT2 size 0xDC
0x13010300 R_GPT3 size 0xDC
0x13010400 R_GPT4 size 0xDC
0x13010500 R_GPT5 size 0xDC
0x13010600 R_GPT6 size 0xDC
0x13010700 R_GPT7 size 0xDC
{0x1301F600+0x100*n} R_GPT{n} size 0xDC (n=10..17)
0x13C60000 R_TZC_DDR00 size 0x1000
0x13C70000 R_TZC_DDR01 size 0x1000
0x13C80000 R_TZC_DDR10 size 0x1000
0x13C90000 R_TZC_DDR11 size 0x1000
0x13CA0000 R_TZC_AXI_RCPU size 0x1000
0x13CB0000 R_TZC_SRAMA size 0x1000
0x13CC0000 R_TZC_PCIE size 0x1000
0x14000000 R_GTM2 size 0x24
0x14001000 R_GTM3 size 0x24
0x14002000 R_TSU_B1 size 0x3C
0x14400000 R_WDT1 size 0x8
0x14400400 R_RIIC0 size 0x14 — IO define file for riic.
0x14400800 R_RIIC1 size 0x14
0x14400C00 R_RIIC2 size 0x14
0x14401000 R_RIIC3 size 0x14
0x14401400 R_RIIC4 size 0x14
0x14401800 R_RIIC5 size 0x14
0x14401C00 R_RIIC6 size 0x14
0x14402000 R_RIIC7 size 0x14
0x14830000 R_DMAC_B1 size 0x800
0x14840000 R_DMAC_B2 size 0x800
0x40049C00 R_SSI0 size 0x28 — IO define file for ssi.
0x4004A000 R_SSI1 size 0x28
0x4004A400 R_SSI2 size 0x28
0x4004A800 R_SSI3 size 0x28
0x40060000 R_SPIBSC size 0x8C — IO define file for spibsc.
