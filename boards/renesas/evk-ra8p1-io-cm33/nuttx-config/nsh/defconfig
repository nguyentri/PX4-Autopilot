## boards/renesas/evk-ra8p1/px4io_cm85/Kconfig
```kconfig
menuconfig BOARD_PX4IO_CM85
	bool "Enable PX4IO CM85 IPC driver"
	default y
	---help---
		Enable the CM85 (FMU) side driver for shared-memory IPC
		communication with the CM33 (IO processor). This replaces
		the traditional serial PX4IO protocol with sub-100µs latency
		shared-memory communication.

if BOARD_PX4IO_CM85

config PX4IO_CM85_SCHEDULE_INTERVAL_US
	int "IPC update interval (microseconds)"
	default 1000
	range 500 10000
	---help---
		Main loop update interval for the px4io_cm85 driver.
		Default: 1000 µs (1kHz)

config PX4IO_CM85_CM33_READY_TIMEOUT_MS
	int "CM33 ready timeout (milliseconds)"
	default 2000
	range 500 10000
	---help---
		Timeout waiting for CM33 to signal ready during boot.
		Default: 2000 ms

config PX4IO_CM85_CM33_HEARTBEAT_TIMEOUT_MS
	int "CM33 heartbeat timeout (milliseconds)"
	default 200
	range 50 1000
	---help---
		Timeout for CM33 heartbeat monitoring. If no heartbeat
		is received within this time, CM85 declares IO failure
		and initiates emergency landing.
		Default: 200 ms

config PX4IO_CM85_HEARTBEAT_PUBLISH_INTERVAL_MS
	int "CM85 heartbeat publish interval (milliseconds)"
	default 100
	range 10 500
	---help---
		Interval for publishing CM85 heartbeat to CM33.
		Default: 100 ms (10 Hz)

endif # BOARD_PX4IO_CM85
```

## boards/renesas/fpb-ra8e1/Kconfig
```kconfig
# Renesas FPB-RA8E1 board configuration

config BOARD_RENESAS_FPB_RA8E1
	bool "Renesas FPB-RA8E1"
	depends on ARCH_CHIP_R7FA8E1AFDCFB
	select ARCH_HAVE_LEDS
	select ARCH_HAVE_BUTTONS
	select ARCH_HAVE_PWM
	select MODULE_SENSORS
	select DRIVERS_IMU_INVENSENSE_ICM20948
	select DRIVERS_BAROMETER_BMP388
	---help---
		Enable support for the Renesas FPB-RA8E1 development board.

if BOARD_RENESAS_FPB_RA8E1

config FPB_RA8E1_HAVE_IMU
	bool "Enable ICM20948 IMU"
	default y
	---help---
		Enable the ICM20948 9-axis IMU on the GY-912 module.

config FPB_RA8E1_HAVE_BARO
	bool "Enable BMP388 Barometer"
	default y
	---help---
		Enable the BMP388 barometer on the GY-912 module.

config FPB_RA8E1_HAVE_MAG
	bool "Enable AK09916 Magnetometer"
	default y
	depends on FPB_RA8E1_HAVE_IMU
	---help---
		Enable the AK09916 magnetometer (part of ICM20948).

endif # BOARD_RENESAS_FPB_RA8E1
```

## boards/renesas/fpb-ra8e1/nuttx-config/nsh/defconfig
```kconfig
#
# FPB-RA8E1 Board Configuration for PX4
#
# CONFIG_DISABLE_ENVIRON is not set
# CONFIG_DISABLE_PSEUDOFS_OPERATIONS is not set
# CONFIG_DISABLE_PTHREAD is not set
# CONFIG_NSH_DISABLEBG is not set
# CONFIG_NSH_DISABLE_CAT is not set
# CONFIG_NSH_DISABLE_CP is not set
# CONFIG_NSH_DISABLE_DF is not set
# CONFIG_NSH_DISABLE_ECHO is not set
# CONFIG_NSH_DISABLE_ENV is not set
# CONFIG_NSH_DISABLE_FREE is not set
# CONFIG_NSH_DISABLE_HELP is not set
# CONFIG_NSH_DISABLE_LS is not set
# CONFIG_NSH_DISABLE_PS is not set
# CONFIG_NSH_DISABLE_SLEEP is not set
CONFIG_ARCH="arm"
CONFIG_ARCH_ARM=y
CONFIG_ARCH_BOARD="fpb-ra8e1"
CONFIG_ARCH_BOARD_FPB_RA8E1=y
CONFIG_ARCH_CHIP="ra8"
CONFIG_ARCH_CHIP_R7FA8E1AFDCFB=y
CONFIG_ARCH_CHIP_RA8=y
CONFIG_ARCH_CORTEXM85=y
CONFIG_ARCH_ARM_MODE="thumb"
CONFIG_ARCH_THUMB=y
CONFIG_ARCH_STACKDUMP=y
CONFIG_ARMV8M_TOOLCHAIN="GNU_EABI"
CONFIG_ARMV8M_DCACHE=y
CONFIG_ARMV8M_DTCM=y
CONFIG_ARMV8M_ICACHE=y
CONFIG_ARMV8M_ITCM=y
CONFIG_BOARD_LOOPSPERMSEC=200000
CONFIG_BUILTIN=y
CONFIG_BUILD_FLAT=y
CONFIG_DEV_CONSOLE=y
CONFIG_DEBUG_ALERT=y
CONFIG_DEBUG_ERROR=y
CONFIG_DEBUG_FEATURES=y
CONFIG_DEBUG_FULLOPT=y
CONFIG_DEBUG_INFO=y
CONFIG_DEBUG_SYMBOLS=y
CONFIG_DEBUG_WARN=y
CONFIG_FS_DEVFS=y
CONFIG_FS_PROCFS=y
CONFIG_IDLETHREAD_STACKSIZE=2048
CONFIG_INIT_ENTRYPOINT="nsh_main"
CONFIG_INTELHEX_BINARY=y
CONFIG_LIBC_FLOATINGPOINT=y
CONFIG_LIBC_LOCALTIME=y
CONFIG_MAX_TASKS=16
CONFIG_NSH_ARCHINIT=y
CONFIG_NSH_BUILTIN_APPS=y
CONFIG_NSH_CONSOLE=y
CONFIG_NSH_FILEIOSIZE=512
CONFIG_NSH_LIBRARY=y
CONFIG_NSH_READLINE=y
CONFIG_PREALLOC_TIMERS=4
CONFIG_PWM=y
CONFIG_RA_CLOCK_PLL1P=y
CONFIG_RA_DTCM=16
CONFIG_RA_FAMILY=y
CONFIG_RA_GPT=y
CONFIG_RA_GPT0=y
CONFIG_RA_GPT2=y
CONFIG_RA_GPT3=y
CONFIG_RA_GPT4=y
CONFIG_I2C=y
CONFIG_RA_I2C=y
CONFIG_RA_I2C3=y
CONFIG_RA_ITCM=16
CONFIG_RA_SCI0_UART=y
CONFIG_RA_SCI2_UART=y
CONFIG_RA_SCI3_UART=y
CONFIG_SPI=y
CONFIG_RA_SPI=y
CONFIG_RA_SPI1=y
CONFIG_RAM_SIZE=524288
CONFIG_RAM_START=0x22060000
CONFIG_RAW_BINARY=y
CONFIG_SCHED_BACKTRACE=y
CONFIG_SCHED_HPWORK=y
CONFIG_SCHED_HPWORKSTACKSIZE=2048
CONFIG_SCHED_LPWORK=y
CONFIG_SCHED_LPWORKSTACKSIZE=2048
CONFIG_SCHED_WAITPID=y
CONFIG_SCI0_BAUD=57600
CONFIG_SCI0_BITS=8
CONFIG_SCI0_PARITY=0
CONFIG_SCI0_RXBUFSIZE=256
CONFIG_SCI0_SERIALDRIVER=y
CONFIG_SCI0_TXBUFSIZE=256
CONFIG_SCI0_2STOP=0
CONFIG_SCI2_BAUD=115200
CONFIG_SCI2_BITS=8
CONFIG_SCI2_PARITY=0
CONFIG_SCI2_RXBUFSIZE=256
CONFIG_SCI2_SERIAL_CONSOLE=y
CONFIG_SCI2_SERIALDRIVER=y
CONFIG_SCI2_TXBUFSIZE=256
CONFIG_SCI2_2STOP=0
CONFIG_SCI3_BAUD=57600
CONFIG_SCI3_BITS=8
CONFIG_SCI3_PARITY=0
CONFIG_SCI3_RXBUFSIZE=256
CONFIG_SCI3_SERIALDRIVER=y
CONFIG_SCI3_TXBUFSIZE=256
CONFIG_SCI3_2STOP=0
CONFIG_SERIAL=y
CONFIG_SERIAL_CONSOLE=y
CONFIG_SIGINT_ACTION=y
CONFIG_SPI_EXCHANGE=y
CONFIG_STANDARD_SERIAL=y
CONFIG_START_DAY=10
CONFIG_START_MONTH=9
CONFIG_START_YEAR=2025
CONFIG_SYSTEM_NSH=y
CONFIG_SYSTEM_NSH_PRIORITY=100
CONFIG_SYSTEM_NSH_STACKSIZE=2048
CONFIG_USEC_PER_TICK=1000
```
