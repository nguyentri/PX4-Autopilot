## boards/renesas/evk-ra8p1-io-cm33/nuttx-config/nsh/defconfig
```kconfig
#
# NuttX Configuration for RA8P1 CM33 IO Processor
#
# This configuration enables the peripherals required for PX4IO functionality
# on the Cortex-M33 core of the RA8P1 dual-core MCU.
#

#
# Architecture Selection
#
CONFIG_ARCH="arm"
CONFIG_ARCH_ARM=y
CONFIG_ARCH_BOARD="evk-ra8p1"
CONFIG_ARCH_BOARD_EVK_RA8P1=y
CONFIG_ARCH_CHIP="ra8"
CONFIG_ARCH_CHIP_RA8=y
CONFIG_ARCH_CHIP_R7KA8P1KFLCAC=y
CONFIG_ARCH_CORTEXM33=y
CONFIG_ARCH_STACKDUMP=y
CONFIG_ARMV8M_DCACHE=y
CONFIG_ARMV8M_DTCM=y
CONFIG_ARMV8M_ICACHE=y
CONFIG_ARMV8M_ITCM=y
CONFIG_ARMV8M_TOOLCHAIN_GNU_EABI=y
# CONFIG_ARMV8M_USEBASEPRI is not set

#
# Board Definition (use NuttX evk-ra8p1 board)
#
CONFIG_BOARD_LOOPSPERMSEC=200000

#
# ARM Mode - Must be THUMB for Cortex-M33
#
CONFIG_ARCH_THUMB=y

#
# Memory Configuration
#
# CM33 Memory Layout:
# - ITCM: 0x20100000, 64KB (code)
# - DTCM: 0x20110000, 64KB (data, stacks)
# - SRAM: 0x22000000, 896KB (heap)
# - IPC:  0x220E0000, 64KB (shared memory, non-cacheable)
#
CONFIG_RAM_START=0x20110000
CONFIG_RAM_SIZE=65536
CONFIG_ARCH_INTERRUPTSTACK=2048
CONFIG_IDLETHREAD_STACKSIZE=1024
CONFIG_RA_DTCM=16
CONFIG_RA_ITCM=16

#
# FPU Configuration
#
CONFIG_ARCH_FPU=y
CONFIG_ARMV8M_LAZYFPU=y

#
# Build Configuration
#
CONFIG_BINFMT_DISABLE=y
CONFIG_DEBUG_FULLOPT=y
CONFIG_DEBUG_SYMBOLS=y
CONFIG_RAW_BINARY=y
CONFIG_INTELHEX_BINARY=y
CONFIG_HAVE_CXX=y
CONFIG_HAVE_CXXINITIALIZE=y

# Disable LED debugging to avoid undefined board_autoled_* references
CONFIG_ARCH_LEDS=n

#
# NuttX Features
#
CONFIG_BUILTIN=y
CONFIG_BUILD_FLAT=y
CONFIG_USER_ENTRYPOINT="nsh_main"
CONFIG_INIT_ENTRYPOINT="nsh_main"
CONFIG_INIT_STACKSIZE=2048
CONFIG_DEV_CONSOLE=y
CONFIG_FDCLONE_STDIO=y
CONFIG_NSH_BUILTIN_APPS=y
CONFIG_NSH_ARCHINIT=y
CONFIG_NSH_READLINE=y
CONFIG_SCHED_HPWORK=y
CONFIG_SCHED_LPWORK=y
CONFIG_SCHED_WORKQUEUE=y
CONFIG_PRIORITY_INHERITANCE=y
CONFIG_SCHED_BACKTRACE=y

#
# Timing and Clocks
#
CONFIG_USEC_PER_TICK=1000
CONFIG_RR_INTERVAL=0
CONFIG_START_YEAR=2026
CONFIG_START_MONTH=1
CONFIG_START_DAY=1
CONFIG_BOARD_LOOPSPERMSEC=200000

#
# Memory Management
#
CONFIG_MM_REGIONS=2
CONFIG_MM_SMALL=y

#
# Clock Configuration
#
CONFIG_RA_CLOCK_PLL1P=y

#
# RA8 Peripheral Drivers
#

# GPT Timers (Motor PWM/DShot)
CONFIG_RA_GPT=y
CONFIG_RA_GPT3=y
CONFIG_RA_GPT5=y
CONFIG_RA_GPT11=y
CONFIG_RA_GPT13=y

# DMAC (DShot frame generation)
CONFIG_RA_DMAC=y
CONFIG_RA_DMAC1=y

# ADC_B (Battery monitoring)
CONFIG_RA_ADC_B=y

# POEG (Emergency stop)
CONFIG_RA_POEG=y

#
# IPC Configuration (shared memory with CM85)
#
CONFIG_RA_IPC=y
CONFIG_RA_IPC_CH0_ENABLE=y
CONFIG_RA_IPC_CH1_ENABLE=y
CONFIG_RA_CPU_CORE_CM33=y
CONFIG_RA_IPC_DEBUG=y
CONFIG_RA_IPC_USE_NMI=y

#
# Serial Configuration (Debug console via SCI)
#
CONFIG_SERIAL=y
CONFIG_STANDARD_SERIAL=y
CONFIG_SCI0_SERIALDRIVER=y
CONFIG_SCI0_SERIAL_CONSOLE=y
CONFIG_SCI0_RXBUFSIZE=256
CONFIG_SCI0_TXBUFSIZE=256
CONFIG_SCI0_BAUD=115200
CONFIG_SCI0_BITS=8
CONFIG_SCI0_PARITY=0
CONFIG_SCI0_2STOP=0
CONFIG_RA_SCI0_UART=y
CONFIG_DEV_CONSOLE=y
CONFIG_SERIAL_CONSOLE=y

#
# NSH Configuration
#
CONFIG_SYSTEM_NSH=y
CONFIG_SYSTEM_NSH_PRIORITY=100
CONFIG_SYSTEM_NSH_STACKSIZE=2048
CONFIG_NSH_CONSOLE=y
CONFIG_NSH_LIBRARY=y

#
# Proc FS
#
CONFIG_FS_PROCFS=y
CONFIG_FS_ROMFS=y
CONFIG_NSH_ROMFSETC=y
CONFIG_NSH_ROMFSSECTSIZE=64
CONFIG_LIBC_LOCALTIME=y
CONFIG_LINE_MAX=64

#
# Spinlock (for multi-core synchronization)
#
CONFIG_SPINLOCK=y

#
# PWM Driver
#
CONFIG_PWM=y

#
# Debug features
#
CONFIG_DEBUG_ALERT=y
CONFIG_DEBUG_ERROR=y
CONFIG_DEBUG_WARN=y
CONFIG_DEBUG_INFO=y
CONFIG_DEBUG_FEATURES=y
```

## boards/renesas/evk-ra8p1-io-cm33/px4io_ipc/Kconfig
```kconfig
############################################################################
# PX4IO IPC Firmware Configuration
#
# Configuration options for the RA8P1 CM33 IO processor firmware
############################################################################

menuconfig MODULES_PX4IOFIRMWARE
	bool "PX4IO IPC Firmware"
	default n
	---help---
		Enable the PX4IO IPC firmware for RA8P1 CM33 core.
		This firmware replaces the traditional PX4IO board by running
		on the Cortex-M33 core of the dual-core RA8P1 MCU.

if MODULES_PX4IOFIRMWARE

config PX4IO_IPC_TRANSPORT
	int "IPC Transport Backend"
	default 0
	range 0 2
	---help---
		Select the IPC transport backend:
		0 = Shared memory with doorbell IRQ (default)
		1 = OpenAMP/RPMsg (requires CONFIG_OPENAMP)
		2 = Custom (user-provided)

config PX4IO_IPC_BUFFER_SIZE
	int "IPC Ring Buffer Size"
	default 4096
	range 1024 16384
	---help---
		Size of each IPC ring buffer (TX and RX) in bytes.
		Larger buffers reduce overflow risk but consume more memory.

config PX4IO_IPC_HEARTBEAT_RATE
	int "IPC Heartbeat Rate (Hz)"
	default 10
	range 1 100
	---help---
		Rate at which heartbeat messages are exchanged between cores.

config PX4IO_IPC_HEARTBEAT_TIMEOUT_MS
	int "FMU Heartbeat Timeout (ms)"
	default 100
	range 50 1000
	---help---
		Timeout for FMU heartbeat. If no heartbeat is received within
		this time, the IO processor enters failsafe mode and may
		trigger POEG motor kill.

menu "Motor Control"

config PX4IO_MOTOR_COUNT
	int "Number of Motor Outputs"
	default 4
	range 1 8
	---help---
		Number of motor outputs. Each motor uses one GPT timer channel.

config PX4IO_PWM_FREQUENCY
	int "PWM Frequency (Hz)"
	default 400
	range 50 2000
	---help---
		PWM output frequency for motors and servos.
		Standard ESCs: 50-400 Hz
		Fast ESCs: 400-1000 Hz

config PX4IO_DSHOT_ENABLE
	bool "Enable DShot Protocol"
	default y
	---help---
		Enable DShot digital protocol for ESC communication.
		DShot provides higher resolution and bidirectional telemetry.

config PX4IO_DSHOT_BITRATE
	int "DShot Bitrate"
	default 600000
	range 150000 1200000
	depends on PX4IO_DSHOT_ENABLE
	---help---
		DShot bitrate:
		150000 = DShot150
		300000 = DShot300
		600000 = DShot600
		1200000 = DShot1200

config PX4IO_DSHOT_TELEMETRY
	bool "Enable DShot Telemetry"
	default n
	depends on PX4IO_DSHOT_ENABLE
	---help---
		Enable bidirectional DShot telemetry (RPM, temperature, current).

endmenu # Motor Control

menu "RC Input"

config PX4IO_RC_SBUS
	bool "Enable S.Bus RC Protocol"
	default y
	---help---
		Enable S.Bus RC receiver protocol (inverted UART @ 100kbps).

config PX4IO_RC_CRSF
	bool "Enable CRSF/ELRS RC Protocol"
	default y
	---help---
		Enable Crossfire/ELRS RC protocol (UART @ 420kbps).

config PX4IO_RC_DSM
	bool "Enable DSM/Spektrum RC Protocol"
	default y
	---help---
		Enable Spektrum DSM RC protocol (UART @ 115.2kbps).

config PX4IO_RC_PPM
	bool "Enable PPM RC Protocol"
	default y
	---help---
		Enable legacy CPPM (pulse position modulation) RC input.

config PX4IO_RC_TIMEOUT_MS
	int "RC Loss Timeout (ms)"
	default 100
	range 50 500
	---help---
		Time without valid RC frames before declaring RC loss.

endmenu # RC Input

menu "Safety Features"

config PX4IO_SAFETY_BUTTON
	bool "Enable Safety Button"
	default y
	---help---
		Enable safety button for arming gate.

config PX4IO_SAFETY_DEBOUNCE_MS
	int "Safety Button Debounce (ms)"
	default 50
	depends on PX4IO_SAFETY_BUTTON
	---help---
		Debounce time for safety button press detection.

config PX4IO_SAFETY_HOLD_MS
	int "Safety Button Hold Time (ms)"
	default 1000
	depends on PX4IO_SAFETY_BUTTON
	---help---
		Required hold time to toggle safety state.

config PX4IO_POEG_ENABLE
	bool "Enable POEG Emergency Kill"
	default y
	---help---
		Enable POEG (Port Output Enable for GPT) for hardware motor kill.
		This provides microsecond-level emergency motor shutdown.

config PX4IO_WATCHDOG_ENABLE
	bool "Enable Watchdog Supervision"
	default y
	---help---
		Enable independent watchdog to reset on main loop hang.

config PX4IO_WATCHDOG_TIMEOUT_MS
	int "Watchdog Timeout (ms)"
	default 500
	depends on PX4IO_WATCHDOG_ENABLE
	---help---
		Watchdog timeout period.

endmenu # Safety Features

menu "ADC Telemetry"

config PX4IO_ADC_VBAT
	bool "Enable Battery Voltage Monitoring"
	default y
	---help---
		Monitor battery voltage via ADC.

config PX4IO_ADC_VBAT_DIVIDER
	int "Battery Voltage Divider Ratio (x10)"
	default 110
	depends on PX4IO_ADC_VBAT
	---help---
		Voltage divider ratio multiplied by 10.
		Example: 110 = 11:1 divider ratio.

config PX4IO_ADC_CURRENT
	bool "Enable Battery Current Monitoring"
	default y
	---help---
		Monitor battery current via ADC + current sense amp.

config PX4IO_ADC_SERVO_RAIL
	bool "Enable Servo Rail Monitoring"
	default y
	---help---
		Monitor servo rail voltage via ADC.

config PX4IO_ADC_BROWNOUT_MV
	int "Brownout Threshold (mV)"
	default 12000
	depends on PX4IO_ADC_VBAT
	---help---
		Battery voltage below this threshold triggers brownout failsafe.

endmenu # ADC Telemetry

menu "Debug Options"

config PX4IO_DEBUG
	bool "Enable Debug Output"
	default n
	---help---
		Enable debug logging to console.

config PX4IO_PERF
	bool "Enable Performance Counters"
	default n
	---help---
		Enable performance monitoring counters.

config PX4IO_IPC_LATENCY_MEASURE
	bool "Measure IPC Latency"
	default n
	---help---
		Measure and report IPC round-trip latency.

endmenu # Debug Options

endif # MODULES_PX4IOFIRMWARE
```

## boards/renesas/evk-ra8p1/Kconfig
```kconfig
# Renesas EVK-RA8P1 board configuration
# Minimal flight controller: IMU + PWM + RC + Telemetry

config BOARD_RENESAS_EVK_RA8P1
	bool \"Renesas EVK-RA8P1\"
	depends on ARCH_CHIP_R7KA8P1KFLCAC
	select ARCH_HAVE_PWM
	select MODULE_SENSORS
	select DRIVERS_IMU_INVENSENSE_ICM20948
	---help---
		Enable support for the Renesas EVK-RA8P1 development board.
		Minimal configuration with ICM20948 IMU on SPI.

if BOARD_RENESAS_EVK_RA8P1

config EVK_RA8P1_HAVE_IMU
	bool \"Enable ICM20948 IMU\"
	default y
	---help---
		Enable the ICM20948 9-axis IMU on the GY-912 module.

config EVK_RA8P1_HAVE_MAG
	bool \"Enable AK09916 Magnetometer\"
	default y
	depends on EVK_RA8P1_HAVE_IMU
	---help---
		Enable the AK09916 magnetometer (part of ICM20948).

endif # BOARD_RENESAS_EVK_RA8P1
```

## boards/renesas/evk-ra8p1/nuttx-config/nsh/defconfig
```kconfig
#
# EVK-RA8P1 Board Configuration for PX4
#
# CONFIG_DISABLE_ENVIRON is not set
# CONFIG_DISABLE_PSEUDOFS_OPERATIONS is not set
# CONFIG_DISABLE_PTHREAD is not set
# CONFIG_NSH_DISABLEBG is not set
# CONFIG_NSH_DISABLE_CAT is not set
# CONFIG_NSH_DISABLE_CP is not set
# CONFIG_NSH_DISABLE_DF is not set
# CONFIG_NSH_DISABLE_ECHO is not set
# CONFIG_NSH_DISABLE_ENV is not set
# CONFIG_NSH_DISABLE_FREE is not set
# CONFIG_NSH_DISABLE_HELP is not set
# CONFIG_NSH_DISABLE_LS is not set
# CONFIG_NSH_DISABLE_PS is not set
# CONFIG_NSH_DISABLE_SLEEP is not set
CONFIG_ARCH="arm"
CONFIG_ARCH_ARM=y
CONFIG_ARCH_BOARD="evk-ra8p1"
CONFIG_ARCH_BOARD_EVK_RA8P1=y
CONFIG_ARCH_CHIP="ra8"
CONFIG_ARCH_CHIP_RA8=y
CONFIG_ARCH_CHIP_R7KA8P1KFLCAC=y
CONFIG_ARCH_CORTEXM85=y
CONFIG_ARCH_FPU=y
CONFIG_ARCH_DPFPU=y
CONFIG_ARCH_ARM_MODE="thumb"
CONFIG_ARCH_THUMB=y
CONFIG_ARCH_STACKDUMP=y
CONFIG_ARMV8M_TOOLCHAIN="GNU_EABI"
CONFIG_ARMV8M_DCACHE=y
CONFIG_ARMV8M_DTCM=y
CONFIG_ARMV8M_ICACHE=y
CONFIG_ARMV8M_ITCM=y
CONFIG_BOARD_LOOPSPERMSEC=200000
CONFIG_BUILTIN=y
CONFIG_BUILD_FLAT=y
CONFIG_DEV_CONSOLE=y
CONFIG_DEBUG_ALERT=y
CONFIG_DEBUG_ERROR=y
CONFIG_DEBUG_FEATURES=y
CONFIG_DEBUG_FULLOPT=y
CONFIG_DEBUG_INFO=y
CONFIG_DEBUG_SYMBOLS=y
CONFIG_DEBUG_WARN=y
CONFIG_FS_DEVFS=y
CONFIG_FS_PROCFS=y
CONFIG_FS_ROMFS=y
CONFIG_HAVE_CXX=y
CONFIG_HAVE_CXXINITIALIZE=y
CONFIG_IDLETHREAD_STACKSIZE=2048
CONFIG_INIT_ENTRYPOINT="nsh_main"
CONFIG_INTELHEX_BINARY=y
CONFIG_LIBC_FLOATINGPOINT=y
CONFIG_LIBC_LOCALTIME=y
CONFIG_MAX_TASKS=32
CONFIG_MAX_TASK_ARGS=8
CONFIG_TASK_NAME_SIZE=24
CONFIG_PTHREAD_STACK_MIN=512
CONFIG_PREALLOC_TIMERS=50
CONFIG_PRIORITY_INHERITANCE=y
CONFIG_NSH_ARCHINIT=y
CONFIG_NSH_BUILTIN_APPS=y
CONFIG_NSH_CONSOLE=y
CONFIG_NSH_FILEIOSIZE=512
CONFIG_NSH_LIBRARY=y
CONFIG_NSH_READLINE=y
CONFIG_PWM=y
CONFIG_RA_CLOCK_PLL1P=y
CONFIG_RA_DTCM=16
CONFIG_RA_FAMILY=y
CONFIG_RA_GPT=y
CONFIG_RA_GPT0=y
CONFIG_RA_GPT3=y
CONFIG_RA_GPT5=y
CONFIG_RA_GPT11=y
CONFIG_RA_GPT13=y
CONFIG_RA_DMAC=y
CONFIG_RA_DMAC_GPT3_CHANNEL=0
CONFIG_RA_DMAC_GPT5_CHANNEL=1
CONFIG_RA_DMAC_GPT11_CHANNEL=2
CONFIG_RA_DMAC_GPT13_CHANNEL=3
CONFIG_I2C=y
CONFIG_RA_I2C=y
CONFIG_RA_I2C0=y
CONFIG_RA_ICU=y
CONFIG_RA_ELC=y
CONFIG_RA_ITCM=16
CONFIG_RA_SCI0_UART=y
CONFIG_RA_SCI4_UART=y
CONFIG_RA_SCI5_UART=y
CONFIG_RA_SCI8_UART=y
CONFIG_SPI=y
CONFIG_RA_SPI=y
CONFIG_RA_SPI0=y
CONFIG_ADC=y
CONFIG_RA_ADC=y
CONFIG_RA_ADC_B=y
CONFIG_RA_ADC_BATTERY_VOLTAGE=y
CONFIG_RA_ADC_BATTERY_CURRENT=y
CONFIG_RA_ADC_ARDUINO=y
CONFIG_RA_DTC=y
CONFIG_RAM_SIZE=524288
CONFIG_RAM_START=0x22060000
CONFIG_RAW_BINARY=y
CONFIG_SCHED_BACKTRACE=y
CONFIG_SCHED_HPWORK=y
CONFIG_SCHED_HPWORKSTACKSIZE=1800
CONFIG_SCHED_INSTRUMENTATION=y
CONFIG_SCHED_INSTRUMENTATION_EXTERNAL=y
CONFIG_SCHED_INSTRUMENTATION_SWITCH=y
CONFIG_SCHED_LPWORK=y
CONFIG_SCHED_LPWORKSTACKSIZE=2032
CONFIG_SCHED_WAITPID=y
CONFIG_SEM_PREALLOCHOLDERS=16
CONFIG_FDCLONE_STDIO=y
CONFIG_SIG_DEFAULT=y
CONFIG_SIG_SIGALRM_ACTION=y
CONFIG_SIG_SIGUSR1_ACTION=y
CONFIG_SIG_SIGUSR2_ACTION=y
CONFIG_STACK_COLORATION=y
CONFIG_SCI0_BAUD=115200
CONFIG_SCI0_BITS=8
CONFIG_SCI0_PARITY=0
CONFIG_SCI0_RXBUFSIZE=256
CONFIG_SCI0_SERIAL_CONSOLE=y
CONFIG_SCI0_SERIALDRIVER=y
CONFIG_SCI0_TXBUFSIZE=256
CONFIG_SCI0_2STOP=0
CONFIG_SCI4_BAUD=57600
CONFIG_SCI4_BITS=8
CONFIG_SCI4_PARITY=0
CONFIG_SCI4_RXBUFSIZE=256
CONFIG_SCI4_SERIALDRIVER=y
CONFIG_SCI4_TXBUFSIZE=256
CONFIG_SCI4_2STOP=0
CONFIG_SCI5_BAUD=57600
CONFIG_SCI5_BITS=8
CONFIG_SCI5_PARITY=0
CONFIG_SCI5_RXBUFSIZE=256
CONFIG_SCI5_SERIALDRIVER=y
CONFIG_SCI5_TXBUFSIZE=256
CONFIG_SCI5_2STOP=0
CONFIG_SCI8_BAUD=57600
CONFIG_SCI8_BITS=8
CONFIG_SCI8_PARITY=0
CONFIG_SCI8_RXBUFSIZE=256
CONFIG_SCI8_SERIALDRIVER=y
CONFIG_SCI8_TXBUFSIZE=256
CONFIG_SCI8_2STOP=0
CONFIG_SERIAL=y
CONFIG_SERIAL_CONSOLE=y
CONFIG_SIGINT_ACTION=y
CONFIG_SPI_EXCHANGE=y
CONFIG_STANDARD_SERIAL=y
CONFIG_START_DAY=10
CONFIG_START_MONTH=9
CONFIG_START_YEAR=2025
CONFIG_SYSTEM_NSH=y
CONFIG_SYSTEM_NSH_PRIORITY=100
CONFIG_SYSTEM_NSH_STACKSIZE=2048
CONFIG_USEC_PER_TICK=1000
CONFIG_SPINLOCK=y

CONFIG_MM_KERNEL_HEAPSIZE=262144
CONFIG_FS_PROCFS=y

# RTT Configuration (for syslog and debug output only)
# CONFIG_SERIAL_RTT_CONSOLE is not set
CONFIG_SERIAL_RTT0=y
CONFIG_SYSLOG_RTT=y
# CONFIG_SYSLOG_CONSOLE is not set
# CONFIG_CONSOLE_SYSLOG is not set
CONFIG_SEGGER_SYSVIEW=y
CONFIG_SEGGER_SYSVIEW_RTT_CHANNEL=0
CONFIG_SEGGER_SYSVIEW_RTT_BUFFER_SIZE=1024
CONFIG_SEGGER_RTT=y
CONFIG_SEGGER_RTT_BUFFER_SIZE_UP=1024
CONFIG_SEGGER_RTT_BUFFER_SIZE_DOWN=16
CONFIG_SEGGER_RTT_PRINTF_BUFFER_SIZE=64

# Enable comprehensive debug output
#CONFIG_DEBUG_SPI=y
#CONFIG_DEBUG_SPI_ERROR=y
#CONFIG_DEBUG_SPI_WARN=y
#CONFIG_DEBUG_SPI_INFO=y

# Enable subsystem debug
CONFIG_DEBUG_GPIO=y
CONFIG_DEBUG_GPIO_ERROR=y
CONFIG_DEBUG_GPIO_WARN=y
CONFIG_DEBUG_GPIO_INFO=y


CONFIG_CPP_HAVE_VARARGS=y
```
