## boards/renesas/rdk-rzv2h/Kconfig
```kconfig
# RDK-RZV2H board Kconfig options

config BOARD_RDK_RZV2H
	bool "Renesas RDK-RZV2H Development Kit"
	default n
	---help---
		Enable support for Renesas RDK-RZV2H Development Kit.
		This board uses a Renesas RZV2H MPU with Cortex-R8 and Cortex-A55 cores.

if BOARD_RDK_RZV2H

config BOARD_RDK_RZV2H_PWM_CHANNELS
	int "Number of PWM channels"
	default 4
	range 1 8
	---help---
		Number of PWM output channels for motor control.
		Default is 4 channels for quadcopter configuration.

config BOARD_RDK_RZV2H_HAS_BARO
	bool "Enable barometer support"
	default y
	---help---
		Enable BMP280 barometer sensor on SCI-mode I2C bus 7.

config BOARD_RDK_RZV2H_HAS_IMU
	bool "Enable IMU support"
	default y
	---help---
		Enable MPU9250 IMU sensor on SPI bus 0.

config BOARD_RDK_RZV2H_HAS_MAG
	bool "Enable magnetometer support"
	default y
	depends on BOARD_RDK_RZV2H_HAS_IMU
	---help---
		Enable AK8963 magnetometer (internal to MPU9250).

config BOARD_RDK_RZV2H_PX4IO_BRIDGE
	bool "Enable the experimental CR8-1 PX4IO bridge"
	default n
	---help---
		Build the CR8-0 uORB bridge for a separately loaded CR8-1 PX4IO
		image. Keep disabled in independent CR8-0 images until the final
		multicore milestone validates IPCC ownership and recovery.

endif # BOARD_RDK_RZV2H
```

## src/systemcmds/serial_status/Kconfig
```kconfig
menuconfig SYSTEMCMDS_SERIAL_STATUS
	bool "serial_status"
	default n
	depends on PLATFORM_NUTTX && BOARD_HAS_RZV_SERIAL_ICOUNT
	---help---
		Snapshot RZ/V2H SCI counters without opening the payload TTY
```
