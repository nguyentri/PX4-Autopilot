# R9A09G057H register map
Vendor: Renesas Electronics; File version: 1.00
Renesas RZ/V2H(P) (R9A09G057H), Cortex-R8 register view
CPU: other r0p3, little endian, MPU, FPU, vendor SysTick, 4 interrupt priority bits, 480 interrupts
Registers are 32-bit, read-write, no defined reset value unless marked. A register's access mark holds for its fields unless they carry their own. Offsets are from the block's base; lines under a group give offsets from that group; [hi:lo] are bit positions; {n}, {i} and the like mark numbered series; 'fields as' and 'values as' point back to an identical list; <NAME> marks a mode.

## Memory map
0x10400000 R_INTC size 0x7A4 — IO define file for intc.
0x10410020 R_GPIO size 0x3C24 — IO define file for gpio.
0x10420010 R_CPG size 0xD20 — IO define file for cpg.
0x10430000 R_SYSC size 0x1710 — IO define file for sysc.
0x10460000 R_TZC_SRAMM size 0x1000 — IO define file for tzc.
0x10470000 R_TZC_XSPI size 0x1000
0x10480000 R_MHU_NS0 size 0x1C — IO define file for mhu.
{0x10480000+0x20*n} R_MHU_NS{n} size 0x1C (n=1..41)
0x10480800 R_MHU_SWINT0 size 0xC — IO define file for mhu.
{0x10480800+0x10*n} R_MHU_SWINT{n} size 0xC (n=1..27)
{0x10481000+0x20*n} R_MHU_S{n} size 0x1C (n=0..41)
0x11000000 R_TSU_B0 size 0x3C — IO define file for tsu_b.
0x11030000 R_XSPI0 size 0x19C — IO define file for xspi.
0x11040000 R_PDM0 size 0x3F0 — IO define file for pdm.
0x11050000 R_PDM1 size 0x3F0
0x11400000 R_DMAC_B0 size 0x800 — IO define file for dmac.
0x11800000 R_GTM0 size 0x24 — IO define file for gtm.
0x11801000 R_GTM1 size 0x24
0x11C00000 R_ADC_E0 size 0x1EC — IO define file for adc_e.
0x11C00400 R_WDT0 size 0x8 — IO define file for wdt.
0x11C00800 R_RTC size 0x30 — IO define file for rtc.
0x11C00C00 R_RTC_RO size 0x10 — IO define file for rtc.
0x11C01000 R_RIIC8 size 0x14
0x11C01400 R_SCIFA0 size 0x18 — IO define file for scifa.
0x11C01800 R_CMTW0 size 0x28 — IO define file for cmtw.
0x11C01C00 R_CMTW1 size 0x28
0x11C02000 R_CMTW2 size 0x28
0x11C02400 R_CMTW3 size 0x28
0x12000000 R_DMAC_B3 size 0x800
0x12010000 R_DMAC_B4 size 0x800
0x12400000 R_I3C_B0 size 0x3E8 — IO define file for i3c.
0x12440000 R_CANFD size 0x1C000 — IO define file for canfd.
0x12800000 R_SPI_B0 size 0x70 — IO define file for spi.
0x12800400 R_SPI_B1 size 0x70
0x12800800 R_SPI_B2 size 0x70
0x12800C00 R_SCI0 size 0x7C — IO define file for rsci.
{0x12800C00+0x400*n} R_SCI{n} size 0x7C (n=1..9)
0x12C00000 R_GTM4 size 0x24
0x12C01000 R_GTM5 size 0x24
0x12C02000 R_GTM6 size 0x24
0x12C03000 R_GTM7 size 0x24
0x12C10000 R_SCU size 0xA0 — IO define file for scu.
0x12C10100 R_INTC_GIC size 0x1F00 — IO define file for intc_gic.
0x12C10200 R_GLOBAL_TIMER size 0x1C — IO define file for global_timer.
0x12C10600 R_PRIVATE_TIMER size 0x38 — IO define file for private_timer.
0x13000000 R_WDT2 size 0x8
0x13000400 R_WDT3 size 0x8
0x13000800 R_CRC size 0x10 — IO define file for crc.
0x13000C00 R_CMTW4 size 0x28
0x13001000 R_CMTW5 size 0x28
0x13001400 R_CMTW6 size 0x28
0x13001800 R_CMTW7 size 0x28
0x13001C00 R_POEGA size 0x4 — IO define file for poeg.
0x13002000 R_POEGB size 0x4
0x13002400 R_POEGC size 0x4
0x13002800 R_POEGD size 0x4
0x13002C00 R_POEGE size 0x4
0x13003000 R_POEGF size 0x4
0x13003400 R_POEGG size 0x4
0x13003800 R_POEGH size 0x4
0x13010000 R_GPT0 size 0xDC — IO define file for gpt.
0x13010100 R_GPT1 size 0xDC
0x13010200 R_GPT2 size 0xDC
0x13010300 R_GPT3 size 0xDC
0x13010400 R_GPT4 size 0xDC
0x13010500 R_GPT5 size 0xDC
0x13010600 R_GPT6 size 0xDC
0x13010700 R_GPT7 size 0xDC
{0x1301F600+0x100*n} R_GPT{n} size 0xDC (n=10..17)
0x13C60000 R_TZC_DDR00 size 0x1000
0x13C70000 R_TZC_DDR01 size 0x1000
0x13C80000 R_TZC_DDR10 size 0x1000
0x13C90000 R_TZC_DDR11 size 0x1000
0x13CA0000 R_TZC_AXI_RCPU size 0x1000
0x13CB0000 R_TZC_SRAMA size 0x1000
0x13CC0000 R_TZC_PCIE size 0x1000
0x14000000 R_GTM2 size 0x24
0x14001000 R_GTM3 size 0x24
0x14002000 R_TSU_B1 size 0x3C
0x14400000 R_WDT1 size 0x8
0x14400400 R_RIIC0 size 0x14 — IO define file for riic.
0x14400800 R_RIIC1 size 0x14
0x14400C00 R_RIIC2 size 0x14
0x14401000 R_RIIC3 size 0x14
0x14401400 R_RIIC4 size 0x14
0x14401800 R_RIIC5 size 0x14
0x14401C00 R_RIIC6 size 0x14
0x14402000 R_RIIC7 size 0x14
0x14830000 R_DMAC_B1 size 0x800
0x14840000 R_DMAC_B2 size 0x800
0x15C30000 R_GBETH0 size 0x1300 — IO define file for tzc.
0x15C40000 R_GBETH1 size 0x1300
0x40049C00 R_SSI0 size 0x28 — IO define file for ssi.
0x4004A000 R_SSI1 size 0x28
0x4004A400 R_SSI2 size 0x28
0x4004A800 R_SSI3 size 0x28
0x40060000 R_SPIBSC size 0x8C — IO define file for spibsc.

## Interrupts
0 NMI (R_INTC)
{n+1} GPIO_IRQ{n} (R_INTC) (n=0..15) — IRQ{n}
{n+17} GTM{n}_OSTM{n}INT (R_GTM{n}) (n=0..7) — OSTM{n}TINT
{n+25} DMAC_B1_DMAINT{n} (R_DMAC_B1) (n=0..15) — DMAC1_DMAINT{n}
{n+41} DMAC_B2_DMAINT{n} (R_DMAC_B2) (n=0..15) — DMAC2_DMAINT{n}
{n+57} DMAC_B3_DMAINT{n} (R_DMAC_B3) (n=0..15) — DMAC3_DMAINT{n}
{n+73} DMAC_B4_DMAINT{n} (R_DMAC_B4) (n=0..15) — DMAC4_DMAINT{n}
{n+89} DMAC_B0_DMAINT{n} (R_DMAC_B0) (n=0..15) — DMAC0_DMAINT{n}
105 SPI0_IDLE (R_SPI_B0) — SPII0
106 SPI0_ERI (R_SPI_B0) — SPEI0
107 SPI0_CE (R_SPI_B0) — SPCEND0
108 SPI1_IDLE (R_SPI_B1) — SPII1
109 SPI1_ERI (R_SPI_B1) — SPEI1
110 SPI1_CE (R_SPI_B1) — SPCEND1
111 SPI2_IDLE (R_SPI_B2) — SPII2
112 SPI2_ERI (R_SPI_B2) — SPEI2
113 SPI2_CE (R_SPI_B2) — SPCEND2
{6n+114} SCI{n}_ERI (R_SCI{n}) (n=0..9) — ERI{n}
{6n+115} SCI{n}_RXI (R_SCI{n}) (n=0..9) — RXI{n}
{6n+116} SCI{n}_TXI (R_SCI{n}) (n=0..9) — TXI{n}
{6n+117} SCI{n}_TEI (R_SCI{n}) (n=0..9) — TEI{n}
{6n+118} SCI{n}_AED (R_SCI{n}) (n=0..9) — AED{n}
{6n+119} SCI{n}_BFD (R_SCI{n}) (n=0..9) — BFD{n}
{6n+174} RIIC{n}_TEI (R_RIIC{n}) (n=0..8) — INTRIICTEI{n}
{6n+175} RIIC{n}_NAKI (R_RIIC{n}) (n=0..8) — INTRIICNAKI{n}
{6n+176} RIIC{n}_SPI (R_RIIC{n}) (n=0..8) — INTRIICSPI{n}
{6n+177} RIIC{n}_STI (R_RIIC{n}) (n=0..8) — INTRIICSTI{n}
{6n+178} RIIC{n}_ALI (R_RIIC{n}) (n=0..8) — INTRIICALI{n}
{6n+179} RIIC{n}_TMOI (R_RIIC{n}) (n=0..8) — INTRIICTMOI{n}
228 XSPI_PULSE (R_XSPI0) — Interrupt pulse signal
229 XSPI_ERR_PULSE (R_XSPI0) — Interrupt pulse signal by error
232 PDM0_INT_DAT0 (R_PDM0) — Data reception interrupt CH0
233 PDM0_INT_DAT1 (R_PDM0) — Data reception interrupt CH1
234 PDM0_INT_DAT2 (R_PDM0) — Data reception interrupt CH2
235 PDM0_INT_SDET (R_PDM0) — Sound detection interrupt (Shared between channels)
236 PDM0_INT_ERR0 (R_PDM0) — Error detection interrupt CH0
237 PDM0_INT_ERR1 (R_PDM0) — Error detection interrupt CH1
238 PDM0_INT_ERR2 (R_PDM0) — Error detection interrupt CH2
239 PDM1_INT_DAT0 (R_PDM1) — Data reception interrupt CH0
240 PDM1_INT_DAT1 (R_PDM1) — Data reception interrupt CH1
241 PDM1_INT_DAT2 (R_PDM1) — Data reception interrupt CH2
242 PDM1_INT_SDET (R_PDM1) — Sound detection interrupt (Shared between channels)
243 PDM1_INT_ERR0 (R_PDM1) — Error detection interrupt CH0
244 PDM1_INT_ERR1 (R_PDM1) — Error detection interrupt CH1
245 PDM1_INT_ERR2 (R_PDM1) — Error detection interrupt CH2
246 ADC0_ADA_COMPAI_N (R_ADC_E0) — ADC Window compare match (windowA)
247 ADC0_ADA_COMPBI_N (R_ADC_E0) — ADC Window compare match (windowB)
248 TSU_B0_S12TSUADI (R_TSU_B0) — S12TSUADI0
249 TSU_B0_S12TSUADCMPI (R_TSU_B0) — S12TSUADCMPI0
250 TSU_B1_S12TSUADI (R_TSU_B1) — S12TSUADI1
251 TSU_B1_S12TSUADCMPI (R_TSU_B1) — S12TSUADCMPI1
252 ICU_SWINT_CR8_0 (R_INTC) — ICU INT_CR8_0
253 ICU_SWINT_CR8_1 (R_INTC) — ICU INT_CR8_1
254 ICU_SWINT_CR8_2 (R_INTC) — ICU INT_CR8_2
255 ICU_SWINT_CR8_3 (R_INTC) — ICU INT_CR8_3
256 CR8_PMUIRQ_0 (R_INTC_GIC) — PMU interrupt signal 0
257 CR8_PMUIRQ_1 (R_INTC_GIC) — PMU interrupt signal 1
258 CR8_SCUEVABORT (R_INTC_GIC) — PMU Indicates that an external abort has occurred during a coherency writeback
259 CR8_FPUFLAGS0_0 (R_INTC_GIC) — Core 0 FPU output flag 0
260 CR8_FPUFLAGS0_1 (R_INTC_GIC) — Core 0 FPU output flag 1
261 CR8_FPUFLAGS0_2 (R_INTC_GIC) — Core 0 FPU output flag 2
262 CR8_FPUFLAGS0_3 (R_INTC_GIC) — Core 0 FPU output flag 3
263 CR8_FPUFLAGS0_4 (R_INTC_GIC) — Core 0 FPU output flag 4
264 CR8_FPUFLAGS0_5 (R_INTC_GIC) — Core 0 FPU output flag 5
265 CR8_FPUFLAGS1_0 (R_INTC_GIC) — Core 1 FPU output flag 0
266 CR8_FPUFLAGS1_1 (R_INTC_GIC) — Core 1 FPU output flag 1
267 CR8_FPUFLAGS1_2 (R_INTC_GIC) — Core 1 FPU output flag 2
268 CR8_FPUFLAGS1_3 (R_INTC_GIC) — Core 1 FPU output flag 3
269 CR8_FPUFLAGS1_4 (R_INTC_GIC) — Core 1 FPU output flag 4
270 CR8_FPUFLAGS1_5 (R_INTC_GIC) — Core 1 FPU output flag 5
271 CR8_RCPU_RAMERR (R_INTC_GIC) — Any ECC error on any RAM
272 CR8_RCPU_FATALRAMERR_0 (R_INTC_GIC) — Fatal ECC error on any RAM core 0
273 CR8_RCPU_FATALRAMERR_1 (R_INTC_GIC) — Fatal ECC error on any RAM core 1
274 CR8_RCPU_FATALERRDET (R_INTC_GIC) — Fatal ECC error on any RAM detect
275 CR8_RCPU_DCEBEMPTY_0 (R_INTC_GIC) — ECC error bank empty for data cache core 0
276 CR8_RCPU_DCEBEMPTY_1 (R_INTC_GIC) — ECC error bank empty for data cache core 1
277 CR8_RCPU_ICEBEMPTY_0 (R_INTC_GIC) — ECC error bank empty for instruction cache core 0
278 CR8_RCPU_ICEBEMPTY_1 (R_INTC_GIC) — ECC error bank empty for instruction cache core 1
279 CR8_RCPU_DTCMEBEMPTY0 (R_INTC_GIC) — ECC error bank empty for DTCM cache core 0
280 CR8_RCPU_DTCMEBEMPTY1 (R_INTC_GIC) — ECC error bank empty for DTCM cache core 1
281 CR8_RCPU_ITCMEBEMPTY0 (R_INTC_GIC) — ECC error bank empty for ITCM cache core 0
282 CR8_RCPU_ITCMEBEMPTY1 (R_INTC_GIC) — ECC error bank empty for ITCM cache core 1
283 CR8_RCPU_SCUEBEMPTY (R_INTC_GIC) — ECC error bank empty for SCU
284 CR8_nCTIIRQ_0 (R_INTC_GIC) — CTI interrupt core 0
285 CR8_nCTIIRQ_1 (R_INTC_GIC) — CTI interrupt core 1
286 CR8_COMMTX_0 (R_INTC_GIC) — Debug communication transmit channel is empty core 0
287 CR8_COMMTX_1 (R_INTC_GIC) — Debug communication transmit channel is empty core 1
288 CR8_COMMRX_0 (R_INTC_GIC) — Debug communication receive channel is empty core 0
289 CR8_COMMRX_1 (R_INTC_GIC) — Debug communication receive channel is empty core 1
290 MHU_MSG3_S (R_MHU_S3) — msg_ch3_s
291 MHU_MSG4_S (R_MHU_S4) — msg_ch4_s
292 MHU_MSG9_S (R_MHU_S9) — msg_ch9_s
293 MHU_MSG10_S (R_MHU_S10) — msg_ch10_s
294 MHU_MSG15_S (R_MHU_S15) — msg_ch15_s
295 MHU_MSG16_S (R_MHU_S16) — msg_ch16_s
296 MHU_MSG21_S (R_MHU_S21) — msg_ch21_s
297 MHU_MSG22_S (R_MHU_S22) — msg_ch22_s
298 MHU_MSG28_S (R_MHU_S28) — msg_ch28_s
299 MHU_MSG34_S (R_MHU_S34) — msg_ch34_s
300 MHU_MSG40_S (R_MHU_S40) — msg_ch40_s
301 MHU_MSG41_S (R_MHU_S41) — msg_ch41_s
302 MHU_RSP3_S (R_MHU_S3) — rsp_ch3_s
303 MHU_RSP4_S (R_MHU_S4) — rsp_ch4_s
304 MHU_RSP9_S (R_MHU_S9) — rsp_ch9_s
305 MHU_RSP10_S (R_MHU_S10) — rsp_ch10_s
306 MHU_RSP15_S (R_MHU_S15) — rsp_ch15_s
307 MHU_RSP16_S (R_MHU_S16) — rsp_ch16_s
308 MHU_RSP21_S (R_MHU_S21) — rsp_ch21_s
309 MHU_RSP22_S (R_MHU_S22) — rsp_ch22_s
310 MHU_RSP28_S (R_MHU_S28) — rsp_ch28_s
311 MHU_RSP34_S (R_MHU_S34) — rsp_ch34_s
312 MHU_RSP40_S (R_MHU_S40) — rsp_ch40_s
313 MHU_RSP41_S (R_MHU_S41) — rsp_ch41_s
314 MHU_MSG3_NS (R_MHU_NS3) — msg_ch3_ns
315 MHU_MSG4_NS (R_MHU_NS4) — msg_ch4_ns
316 MHU_MSG9_NS (R_MHU_NS9) — msg_ch9_ns
317 MHU_MSG10_NS (R_MHU_NS10) — msg_ch10_ns
318 MHU_MSG15_NS (R_MHU_NS15) — msg_ch15_ns
319 MHU_MSG16_NS (R_MHU_NS16) — msg_ch16_ns
320 MHU_MSG21_NS (R_MHU_NS21) — msg_ch21_ns
321 MHU_MSG22_NS (R_MHU_NS22) — msg_ch22_ns
322 MHU_MSG28_NS (R_MHU_NS28) — msg_ch28_ns
323 MHU_MSG34_NS (R_MHU_NS34) — msg_ch34_ns
324 MHU_MSG40_NS (R_MHU_NS40) — msg_ch40_ns
325 MHU_MSG41_NS (R_MHU_NS41) — msg_ch41_ns
326 MHU_RSP3_NS (R_MHU_NS3) — rsp_ch3_ns
327 MHU_RSP4_NS (R_MHU_NS4) — rsp_ch4_ns
328 MHU_RSP9_NS (R_MHU_NS9) — rsp_ch9_ns
329 MHU_RSP10_NS (R_MHU_NS10) — rsp_ch10_ns
330 MHU_RSP15_NS (R_MHU_NS15) — rsp_ch15_ns
331 MHU_RSP16_NS (R_MHU_NS16) — rsp_ch16_ns
332 MHU_RSP21_NS (R_MHU_NS21) — rsp_ch21_ns
333 MHU_RSP22_NS (R_MHU_NS22) — rsp_ch22_ns
334 MHU_RSP28_NS (R_MHU_NS28) — rsp_ch28_ns
335 MHU_RSP34_NS (R_MHU_NS34) — rsp_ch34_ns
336 MHU_RSP40_NS (R_MHU_NS40) — rsp_ch40_ns
337 MHU_RSP41_NS (R_MHU_NS41) — rsp_ch41_ns
338 MHU_SW_MHU_INT0 (R_MHU_SWINT0) — sw_mhu_int_0
339 MHU_SW_MHU_INT1 (R_MHU_SWINT1) — sw_mhu_int_1
340 MHU_SW_MHU_INT3 (R_MHU_SWINT3) — sw_mhu_int_3
341 MHU_SW_MHU_INT4 (R_MHU_SWINT4) — sw_mhu_int_4
342 MHU_SW_MHU_INT6 (R_MHU_SWINT6) — sw_mhu_int_6
343 MHU_SW_MHU_INT7 (R_MHU_SWINT7) — sw_mhu_int_7
344 MHU_SW_MHU_INT9 (R_MHU_SWINT9) — sw_mhu_int_9
345 MHU_SW_MHU_INT10 (R_MHU_SWINT10) — sw_mhu_int_10
346 MHU_SW_MHU_INT26 (R_MHU_SWINT26) — sw_mhu_int_26
347 MHU_SW_MHU_INT27 (R_MHU_SWINT27) — sw_mhu_int_27
348 WDT2_WDTINT (R_WDT2) — Down-counter underflow/refresh error
349 WDT3_WDTINT (R_WDT3) — Down-counter underflow/refresh error
350 GIC_FAULT_INT (R_INTC_GIC)
351 GIC_ERR_INT (R_INTC_GIC)
352 GIC_PMU_INT (R_INTC_GIC)
{n+353} SEL{n} (R_INTC) (n=0..126) — SELECT{n}
